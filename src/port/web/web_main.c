/**
 ******************************************************************************
 * @brief:  The demo of the AK Base Kit in a web browser (WebAssembly).
 *
 *  What runs is the firmware itself: kernel, the sample app with its shell
 *  and Modbus slave, and the demo screens - the same sources as on the kit.
 *  Only the lowest layer differs: the host port (port/host) stands in for the
 *  chip, and this file stands in for the board (demo/kit.h): display, buttons,
 *  buzzer, clock, sensor and SPI flash become memory the page reads and writes.
 *
 *  The kernel never gets to run its endless loop here; the page calls
 *  web_tick() a hundred times a second and each call lets the kernel handle
 *  what became due (task_run_once).
 *
 *  Build: python port/web/build.py  (needs the Emscripten SDK)
 ******************************************************************************
**/

#include <setjmp.h>
#include <stdint.h>
#include <string.h>
#include <time.h>

#include <emscripten.h>

#include "ak.h"
#include "task.h"
#include "xprintf.h"

#include "hal.h"
#include "port_host.h"

#include "app.h"
#include "kit.h"
#include "ui.h"
#include "blk_vm.h"

#include "clip_data.h"				/* generated by build.py from port/web/clip.akv */

#define STORE_SIZE		(512UL * 1024UL)
#define IO_SIZE			(4096)

static uint8_t panel[KIT_LCD_PAGES][KIT_LCD_W];
static uint8_t buttons;
static uint16_t buzzer_hz;
static uint8_t store[STORE_SIZE];
static uint8_t io[IO_SIZE];			/* bytes on their way between the page and the firmware */
static int32_t rtc_offset_s;
static uint8_t started;
static jmp_buf stop_jmp;			/* FATAL or reset: back out of the kernel */
static uint8_t stop_reason;			/* 1 = reset asked by the firmware */
static uint8_t want_fatal;			/* the page asked for a FATAL, to show the crash log */

/*----------------------------------------------------------------------------
 * demo/kit.h
 *--------------------------------------------------------------------------*/
uint8_t kit_init(void) {
	return 1;
}

uint8_t kit_lcd_write_page(uint8_t page, const uint8_t* data) {
	memcpy(panel[page], data, KIT_LCD_W);
	return 1;
}

uint8_t kit_buttons(void) {
	return buttons;
}

void kit_buzzer(uint16_t freq_hz) {
	buzzer_hz = freq_hz;
}

/* the clock of the computer; setting it on the kit only moves an offset */
uint8_t kit_rtc_get(uint8_t* hh, uint8_t* mm, uint8_t* ss) {
	time_t t = time(0) + rtc_offset_s;
	struct tm* tm = localtime(&t);

	*hh = (uint8_t)tm->tm_hour;
	*mm = (uint8_t)tm->tm_min;
	*ss = (uint8_t)tm->tm_sec;
	return 1;
}

uint8_t kit_rtc_set(uint8_t hh, uint8_t mm, uint8_t ss) {
	uint8_t h, m, s;

	kit_rtc_get(&h, &m, &s);
	rtc_offset_s += ((int32_t)hh - h) * 3600 + ((int32_t)mm - m) * 60 + ((int32_t)ss - s);
	return 1;
}

/* no sensor in a browser: a slow wave, so the graph has something to draw */
uint8_t kit_sht_start(void) {
	return 1;
}

uint8_t kit_sht_read(int16_t* t10, uint16_t* rh10) {
	uint32_t now = hal_millis();

	*t10 = (int16_t)(265 + ui_sin((uint8_t)(now / 700)) * 9 / 127 + ui_sin((uint8_t)(now / 130)) / 64);
	*rh10 = (uint16_t)(610 - ui_sin((uint8_t)(now / 900)) * 40 / 127);
	return 1;
}

/* no I2C header in a browser */
uint8_t kit_i2c_probe(uint8_t addr) {
	(void)addr;
	return 0;
}

uint8_t kit_i2c_read(uint8_t addr, uint8_t reg, uint8_t* buf, uint8_t len) {
	(void)addr;
	(void)reg;
	(void)buf;
	(void)len;
	return 0;
}

void kit_i2c_watch(uint32_t n, uint32_t* scl_high, uint32_t* sda_high, uint32_t* scl_edges, uint32_t* sda_edges) {
	*scl_high = *sda_high = n;
	*scl_edges = *sda_edges = 0;
}

/* no SPI header in a browser */
void kit_spi_sniff_start(uint8_t mode, uint16_t trig) {
	(void)mode;
	(void)trig;
}

void kit_spi_sniff_stop(void) {
}

uint8_t kit_spi_sniff_status(uint16_t* bytes, uint16_t* frames) {
	*bytes = *frames = 0;
	return 0;
}

uint8_t kit_spi_sniff_frame(uint16_t i, const uint8_t** data, uint16_t* len, uint32_t* dt_us) {
	(void)i;
	(void)data;
	(void)len;
	(void)dt_us;
	return 0;
}

void kit_spi_watch(uint32_t n, uint8_t pull, uint32_t high[3], uint32_t edges[3]) {
	(void)pull;
	for (uint8_t k = 0; k < 3; k++) {
		high[k] = n;
		edges[k] = 0;
	}
}

uint32_t kit_store_size(void) {
	return STORE_SIZE;
}

uint8_t kit_store_read(uint32_t off, void* buf, uint32_t len) {
	if (off > STORE_SIZE || len > STORE_SIZE - off) {
		return 0;
	}
	memcpy(buf, store + off, len);
	return 1;
}

uint8_t kit_store_erase(uint32_t off) {
	if (off % KIT_STORE_SECTOR || off >= STORE_SIZE) {
		return 0;
	}
	memset(store + off, 0xFF, KIT_STORE_SECTOR);
	return 1;
}

uint8_t kit_store_write(uint32_t off, const void* data, uint32_t len) {
	if (off > STORE_SIZE || len > STORE_SIZE - off) {
		return 0;
	}
	for (uint32_t i = 0; i < len; i++) {
		store[off + i] &= ((const uint8_t*)data)[i];		/* like NOR flash: bits only go to 0 */
	}
	return 1;
}

/*----------------------------------------------------------------------------
 * start, stop
 *--------------------------------------------------------------------------*/
static void on_reset(void) {
	stop_reason = 1;
	longjmp(stop_jmp, 1);
}

static void start(void) {
	if (!started) {
		host_reset_state(0xFF);
		memset(store, 0xFF, sizeof(store));
		memcpy(store, clip_data, sizeof(clip_data));
		host_console_use_stdio(0);
		host_console_rx_guard(0);			/* an idle console is normal here */
		host_use_virtual_time(1);
		host_fatal_jmp = &stop_jmp;
		host_reset_handler = on_reset;
	}
	started = 1;
	buzzer_hz = 0;
	hal_init();
	app_init();
}

/*----------------------------------------------------------------------------
 * what the page calls
 *--------------------------------------------------------------------------*/
/* Lets the firmware run for elapsed_ms of its time. */
EMSCRIPTEN_KEEPALIVE void web_tick(uint32_t elapsed_ms) {
	static uint8_t restart = 1;

	if (setjmp(stop_jmp)) {
		/* the firmware stopped itself: say why, start again at the next tick */
		if (stop_reason) {
			xprintf("\n[web] reset\n");
		}
		else {
			uint32_t tag = 0;

			/* what the chip port keeps in RAM across the reset: the next start
			 * finds it and writes it into the crash log (shell: crash) */
			if (host_fatal_str) {
				strncpy((char*)&tag, host_fatal_str, sizeof(tag));
			}
			host_crash_inject(HAL_CRASH_FATAL, host_fatal_code, 0, 0, tag);
			host_set_last_dispatch(host_cur_task(), host_cur_sig());
			host_set_reset_reason(HAL_RESET_REASON_SOFTWARE);
			xprintf("\n[web] FATAL %s 0x%02X - restarting\n", host_fatal_str ? host_fatal_str : "?", host_fatal_code);
		}
		stop_reason = 0;
		restart = 1;
		return;
	}
	if (restart) {
		restart = 0;
		start();
	}
	if (want_fatal) {
		want_fatal = 0;
		FATAL("TEST", 0x55);
	}
	while (elapsed_ms) {
		uint32_t step = elapsed_ms > 2 ? 2 : elapsed_ms;

		elapsed_ms -= step;
		host_advance_ms(step);
		host_service();						/* the 1 ms tick of the kernel timers */
		for (uint8_t i = 0; i < 20 && task_run_once(); i++) {
		}
	}
}

/* The next tick ends in a FATAL, as a firmware bug would. */
EMSCRIPTEN_KEEPALIVE void web_test_fatal(void) {
	want_fatal = 1;
}

EMSCRIPTEN_KEEPALIVE uint8_t* web_panel(void) {
	return &panel[0][0];
}

EMSCRIPTEN_KEEPALIVE void web_buttons(uint8_t mask) {
	buttons = mask;
}

EMSCRIPTEN_KEEPALIVE uint16_t web_buzzer(void) {
	return buzzer_hz;
}

EMSCRIPTEN_KEEPALIVE uint8_t web_led(void) {
	return host_led();
}

EMSCRIPTEN_KEEPALIVE void web_autoplay(uint8_t on) {
	ui_autoplay = on;
}

EMSCRIPTEN_KEEPALIVE uint8_t web_autoplay_state(void) {
	return ui_autoplay;
}

/* Opens the screen named by the text in io[] (0-terminated), "menu" = the menu. */
EMSCRIPTEN_KEEPALIVE uint8_t web_open(void) {
	io[IO_SIZE - 1] = 0;
	return started ? ui_open((const char*)io) : 0;
}

/* a block program of n bytes in io[]: load it and open the Blocks screen.
 * Returns 0 on success, else the BLK_ERR_* code. */
EMSCRIPTEN_KEEPALIVE uint8_t web_blk_load(uint32_t n) {
	uint8_t err;

	if (!started || n > BLK_MAX_SIZE) {
		return BLK_ERR_IMAGE;
	}
	err = blk_load(io, (uint16_t)n);
	if (err == BLK_OK) {
		ui_open("blocks");
	}
	return err;
}

EMSCRIPTEN_KEEPALIVE uint8_t* web_io(void) {
	return io;
}

/* console (UART of the kit): n bytes from io[] in, returns bytes put into io[] */
EMSCRIPTEN_KEEPALIVE void web_console_in(uint32_t n) {
	host_console_inject(io, n > IO_SIZE ? IO_SIZE : n);
}

EMSCRIPTEN_KEEPALIVE uint32_t web_console_out(void) {
	return host_console_take_tx(io, IO_SIZE);
}

/* RS485: the page carries the bytes to another page (Pong for two) */
EMSCRIPTEN_KEEPALIVE void web_rs485_in(uint32_t n) {
	host_rs485_inject(io, n > IO_SIZE ? IO_SIZE : n);
}

EMSCRIPTEN_KEEPALIVE uint32_t web_rs485_out(void) {
	return host_rs485_take_tx(io, IO_SIZE);
}

/* media store (SPI flash): the page may put a clip of its own there */
EMSCRIPTEN_KEEPALIVE uint8_t* web_store(void) {
	return store;
}

EMSCRIPTEN_KEEPALIVE uint32_t web_store_size(void) {
	return STORE_SIZE;
}
